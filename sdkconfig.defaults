## sdkconfig.defaults
```kconfig
# Rust often needs a bit of an extra main task stack size compared to C (the default is 3K)
#CONFIG_ESP_MAIN_TASK_STACK_SIZE=16384
CONFIG_ESP_MAIN_TASK_STACK_SIZE=32768

CONFIG_ESP_SYSTEM_EVENT_TASK_STACK_SIZE=4096
CONFIG_PTHREAD_TASK_STACK_SIZE_DEFAULT=4096
CONFIG_FREERTOS_IDLE_TASK_STACKSIZE=4096

# Use this to set FreeRTOS kernel tick frequency to 1000 Hz (100 Hz by default).
# This allows to use 1 ms granularity for thread sleeps (10 ms by default).
CONFIG_FREERTOS_HZ=1000

# These are not necessary, the application bundles its own certificates
# CONFIG_MBEDTLS_CERTIFICATE_BUNDLE=n
# CONFIG_MBEDTLS_CERTIFICATE_BUNDLE_DEFAULT_FULL=n

# This must be disabled, otherwise there are repeated crashes in the logs,
# because of a watchdog timer not being reset.
CONFIG_ESP_TASK_WDT_EN=n

#
# Partition Table
#
CONFIG_PARTITION_TABLE_SINGLE_APP=y
CONFIG_PARTITION_TABLE_SINGLE_APP_LARGE=y
CONFIG_PARTITION_TABLE_CUSTOM_FILENAME="partitions.csv"
CONFIG_PARTITION_TABLE_FILENAME="partitions_singleapp.csv"
CONFIG_PARTITION_TABLE_OFFSET=0x8000
CONFIG_PARTITION_TABLE_MD5=y
# end of Partition Table

#CONFIG_LOG_DEFAULT_LEVEL_VERBOSE=y

# Enable PSRAM, because 512KB is not enough for web requests
CONFIG_SPIRAM=y
CONFIG_SPIRAM_MODE_QUAD=y
CONFIG_SPIRAM_SPEED_40M=y

# Matter/Bluetooth
CONFIG_BT_BTC_TASK_STACK_SIZE=15000
CONFIG_BT_ENABLED=y
CONFIG_BT_BLUEDROID_ENABLED=y
CONFIG_BT_CLASSIC_ENABLED=n
CONFIG_BTDM_CTRL_MODE_BLE_ONLY=y
CONFIG_BTDM_CTRL_MODE_BR_EDR_ONLY=n
CONFIG_BTDM_CTRL_MODE_BTDM=n
CONFIG_BT_A2DP_ENABLE=n
CONFIG_BT_BLE_42_FEATURES_SUPPORTED=y
CONFIG_BT_BLE_50_FEATURES_SUPPORTED=n
CONFIG_BT_BLE_DYNAMIC_ENV_MEMORY=y

# Wifi/Thread + BLE coex
CONFIG_ESP_COEX_SW_COEXIST_ENABLE=y

# Async SPI only enabled when this config is disabled (it is enabled by default)
CONFIG_SPI_MASTER_ISR_IN_IRAM=n

# Colored terminal not enabled by default since ESP-IDF V5.5
CONFIG_LOG_COLORS=y
```
